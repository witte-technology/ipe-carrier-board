// Verdin iMX8MP overlay to enable SODIMM 56 as GPIO on Ipê Board.

/dts-v1/;
/plugin/;

/ {
	compatible = "toradex,verdin-imx8mp";
};

#include <dt-bindings/interrupt-controller/arm-gic.h>
#include <dt-bindings/gpio/gpio.h>
#include <dt-bindings/../../arch/arm64/boot/dts/freescale/imx8mp-pinfunc.h>

/* Verdin QSPI_1 */
&flexspi {
	status = "disabled";
};

&iomuxc {
	pinctrl-0 = <&pinctrl_gpio1>, <&pinctrl_gpio2>,
		    <&pinctrl_gpio3>, <&pinctrl_gpio4>,
		    <&pinctrl_gpio7>, <&pinctrl_gpio8>,
		    <&pinctrl_gpio_hog2>, <&pinctrl_gpio_hog3>, <&pinctrl_gpio_hog4>,
		    <&pinctrl_sodimm_56>, <&pinctrl_hdmi_hog>;

	pinctrl_sodimm_56: witty56 {
		fsl,pins = 
			<MX8MP_IOMUXC_NAND_DATA00__GPIO3_IO06		0x184>; /* SODIMM 56 */
	};
};